// Hardkernel I2C RTC

/dts-v1/;
/plugin/;

/ {
	fragment@0 {
		target = <&i2c_A>;
//		target-path = "/soc/cbus@c1100000/i2c@8500"
		__overlay__ {
			status = "okay";
			#address-cells = <1>;
			#size-cells = <0>;
			pcf8563: pcf8563@51 {
				status = "okay";
				compatible = "nxp,pcf8563";
				reg = <0x51>;
				#clock-cells = <0x00>;
			};
		};
	};
};
